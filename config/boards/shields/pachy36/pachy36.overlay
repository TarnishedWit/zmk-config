#include <dt-bindings/zmk/matrix_transform.h>
#include "pachy36.dtsi"

/ {
	chosen {
		zmk,kscan = &kscan0;
		zmk,matrix_transform = &default_transform;
		zephyr,display = &nice_view_spi;
	};
	
	kscan0: kscan_0 {
		compatible = "zmk,kscan-gpio-matrix";
		label = "KSCAN";
		diode-direction = "col2row";
		
		col-gpios
			= <&pro_micro 3 GPIO_ACTIVE_HIGH>
			, <&pro_micro 4 GPIO_ACTIVE_HIGH>
			, <&pro_micro 5 GPIO_ACTIVE_HIGH>
			, <&pro_micro 6 GPIO_ACTIVE_HIGH>
			, <&pro_micro 7 GPIO_ACTIVE_HIGH>
			, <&pro_micro 8 GPIO_ACTIVE_HIGH>
			, <&pro_micro 9 GPIO_ACTIVE_HIGH>
			, <&pro_micro 10 GPIO_ACTIVE_HIGH>
			, <&pro_micro 16 GPIO_ACTIVE_HIGH>
			, <&pro_micro 14 GPIO_ACTIVE_HIGH>
			;
	};
	



